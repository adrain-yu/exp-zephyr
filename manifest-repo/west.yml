## manifest-repo/west.yml
```yaml
manifest:
  remotes:
    - name: zephyrproject-rtos
      url-base: git@github.com:zephyrproject-rtos
  projects:
    - name: zephyr
      remote: zephyrproject-rtos
      revision: v3.6.0
      import:
        name-allowlist:
          - hal_espressif
          - hal_nordic
          - cmsis
  self:
    path: manifest-repo
```
