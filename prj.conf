## CMakeLists.txt
```
# 指定需要cmake的最低版本
cmake_minimum_required(VERSION 3.20.0)

# 通过cmake package加入Zephyr构建系统
find_package(Zephyr REQUIRED HINTS $ENV{ZEPHYR_BASE})

# 指定应用工程名称为zpro，必须在find_package后
project(zpro)

# 将应用的代码加入构建，必须在find_package后
target_sources(app PRIVATE src/main.c)

target_sources_ifdef(CONFIG_LOGGING_SAMPLE app PRIVATE  src/log_sample/simple.c
							src/log_sample/simple_co.c
							src/shell_sample.c
)
```

## Kconfig
```
mainmenu "Zephyr Kernel Configuration"
# 添加应用配置菜单，名为"Application Configuration"
menu "Application Configuration"
    # 增加一个配置项，配置是否启用logging的示例代码
    # 默认选中该配置项，选择该配置项时也将选择Zephyr本身的CONFIG_LOG
    config LOGGING_SAMPLE
        bool "Enable logging sample code"
        select LOG
        default y
endmenu
source "Kconfig.zephyr"
```

## west.yml
```
manifest:
  remotes:
    - name: zephyrproject-rtos
      url-base: https://github.com/zephyrproject-rtos
  projects:
    - name: zephyr
      remote: zephyrproject-rtos
      revision: zephyr-v3.0.0
      clone-depth: 1
      import:
        name-allowlist:
          - hal_espressif
          - hal_nordic
          - cmsis
  self:
    west-commands: scripts/west-commands.yml
```

## prj.conf
```kconfig
CONFIG_BOOT_BANNER=y

CONFIG_HEAP_MEM_POOL_SIZE=256

# Flash, flash驱动依赖k_malloc

# NVS，依赖Flash

# 为调试使用
CONFIG_SHELL=y
CONFIG_LOG=y
CONFIG_NVS_LOG_LEVEL_DBG=y
CONFIG_FLASH_LOG_LEVEL_DBG=y

CONFIG_NO_OPTIMIZATIONS=y    //编译不进行优化
CONFIG_DEBUG=y                //Build kernel with debugging enabled
CONFIG_LOG_BACKEND_UART=y
CONFIG_LOG_CMDS=y
CONFIG_LOGGING_SAMPLE=y
CONFIG_SHELL_PROMPT_UART="shell:~$ "
```

## src/main.c
```c
/*
 * Copyright (c) 2022 Frank.
 *
 * SPDX-License-Identifier: Apache-2.0
 */

#include <zephyr/kernel.h>
#include <zephyr/shell/shell.h>
#include <zephyr/logging/log.h>
#include <zephyr/sys/util.h>

#define STACKSIZE 1024
//注册一个名为main的log frontend, build-in level为LOG_LEVEL_DBG
LOG_MODULE_REGISTER(main, LOG_LEVEL_DBG);

static K_THREAD_STACK_DEFINE(stack, STACKSIZE);
static struct k_thread main_thread;

static void log_thread_fun(void *p1, void *p2, void *p3)
{
    int i = 0;
    while(1){
        LOG_ERR("main err %d", i++);    //ERR Level log
        LOG_WRN("main wrn");            //WRN Level log
        LOG_INF("main info");           //INFO Level log
        LOG_DBG("main dbg");            //DBG Level log
        //k_sleep(1000);
	k_sleep(K_MSEC(1000000000));
    }
}
extern void simple_logging(void);
extern void simple_co_logging(void);
int main(void)
{
    simple_logging();
    k_thread_create(&main_thread, stack, STACKSIZE, log_thread_fun, NULL, NULL,
			NULL, K_PRIO_COOP(7), 0, K_NO_WAIT);

    simple_co_logging();

    return 0;
}
```

## src/nvs_sample.c
```c
#include <zephyr.h>
#include <shell/shell.h>

#include <drivers/flash.h>
#include <storage/flash_map.h>
#include <fs/nvs.h>

static struct nvs_fs fs;

#define STORAGE_NODE_LABEL storage


static int nvs_cmd_show(const struct shell *shell, size_t argc, char **argv)
{

}

static int nvs_cmd_init(const struct shell *shell, size_t argc, char **argv)
{
    int rc = 0;
    struct flash_pages_info info;
	const struct device *flash_dev;

	flash_dev = FLASH_AREA_DEVICE(STORAGE_NODE_LABEL);
	if (!device_is_ready(flash_dev)) {
		printk("Flash device %s is not ready\n", flash_dev->name);
		return;
	}
	fs.offset = FLASH_AREA_OFFSET(storage);
	rc = flash_get_page_info_by_offs(flash_dev, fs.offset, &info);
	if (rc) {
		printk("Unable to get page info\n");
		return;
	}
	fs.sector_size = info.size*2;
	fs.sector_count = 3U;

	rc = nvs_init(&fs, flash_dev->name);
	if (rc) {
		printk("Flash Init failed\n");
		return;
	}
}

static int nvs_cmd_erase(const struct shell *shell, size_t argc, char **argv)
{
    int rc = 0;
    struct flash_pages_info info;
	const struct device *flash_dev;
    struct flase_area *storage_area = NULL;

	flash_dev = FLASH_AREA_DEVICE(STORAGE_NODE_LABEL);
	if (!device_is_ready(flash_dev)) {
		printk("Flash device %s is not ready\n", flash_dev->name);
		return;
	}
	fs.offset = FLASH_AREA_OFFSET(storage);
	rc = flash_get_page_info_by_offs(flash_dev, fs.offset, &info);
	if (rc) {
		printk("Unable to get page info\n");
		return;
	}
	fs.sector_size = info.size;
	fs.sector_count = 3U;

    rc = flash_area_open(FLASH_AREA_ID(STORAGE_NODE_LABEL), &storage_area);
    if (rc) {
		printk("flash_area_open fail\n");
		return;
	}

	rc = flash_area_erase(storage_area, 0, fs.sector_count*fs.sector_size);
    if (rc) {
		printk("erase page fail\n");
		return;
	}
}

SHELL_STATIC_SUBCMD_SET_CREATE(sub_nvs,
			       SHELL_CMD(show, NULL, "show nvs info", nvs_cmd_show),
                   SHELL_CMD(init, NULL, "nvs init", nvs_cmd_init),
                   SHELL_CMD(erase, NULL, "nvs init", nvs_cmd_erase),
			       SHELL_SUBCMD_SET_END
			       );

SHELL_CMD_REGISTER(nvs, &sub_nvs, "nvs test commands", NULL);
```

## src/shell_sample.c
```c
#include <stdlib.h>
#include <zephyr/kernel.h>
#include <version.h>
#include <zephyr/shell/shell.h>

static int cmd_info_board(const struct shell *sh, size_t argc, char **argv)
{
	ARG_UNUSED(argc);
	ARG_UNUSED(argv);

	shell_print(sh, CONFIG_BOARD);
	shell_info(sh, CONFIG_BOARD);
	shell_warn(sh, CONFIG_BOARD);
	shell_error(sh, CONFIG_BOARD);


	return 0;
}

static int cmd_info_version(const struct shell *sh, size_t argc, char **argv)
{
	ARG_UNUSED(argc);
	ARG_UNUSED(argv);

	shell_print(sh, "Zephyr version %s", KERNEL_VERSION_STRING);

	return 0;
}


static int cmd_shell_help(const struct shell *sh, size_t argc, char **argv)
{
	shell_print(sh, "show help: %d", argc);
    if(argc == 1){
        shell_help(sh);
        return SHELL_CMD_HELP_PRINTED;
    }

	for(size_t i=0; i< argc; i++){
		shell_print(sh, "check arg %d: %s", i, argv[i]);
	}

	return 0;
}

/* SHELL_CMD 注册两个子命令， board和version，执行时会调用cmd_info_board和cmd_info_version函数
   SHELL_STATIC_SUBCMD_SET_CREATE 将子命令组装成子命令集subinfo
   SHELL_SUBCMD_SET_END表示子命令集的结束
 */
SHELL_STATIC_SUBCMD_SET_CREATE(subinfo,
    SHELL_CMD(board, NULL, "Show board command.", cmd_info_board),
    SHELL_CMD(version, NULL, "Show info command.", cmd_info_version),
    SHELL_SUBCMD_SET_END /* Array terminated. */
);

/* 注册一个根命令shell_sample，执行根命令shell_sample时会调用cmd_shell_help
    shell_sample的子命令集为
 */
SHELL_CMD_REGISTER(shell_sample, &subinfo, "Sample commands", cmd_shell_help);
```
